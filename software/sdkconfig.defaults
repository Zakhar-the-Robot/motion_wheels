## software/sdkconfig.defaults
```kconfig
CONFIG_ESP_SYSTEM_PANIC_PRINT_HALT=y

CONFIG_BT_ENABLED=y
CONFIG_BTDM_CTRL_MODE_BLE_ONLY=n
CONFIG_BTDM_CTRL_MODE_BR_EDR_ONLY=y
CONFIG_BTDM_CTRL_MODE_BTDM=n
CONFIG_BT_CLASSIC_ENABLED=y
CONFIG_WIFI_ENABLED=n
CONFIG_BT_SPP_ENABLED=y
CONFIG_BT_BLE_ENABLED=n

CONFIG_MPU9255=y
CONFIG_MPU_I2C=y
CONFIG_MPU_COMM_PROTOCOL="I2C"
CONFIG_MPU_LOG_LEVEL_INFO=y
CONFIG_MPU_LOG_LEVEL=3
```
